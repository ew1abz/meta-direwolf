## conf/layer.conf
```bitbake
# We have a conf and classes directory, add to BBPATH
BBPATH .= ":${LAYERDIR}"

# We have a packages directory, add to BBFILES
BBFILES += "${LAYERDIR}/recipes*/*/*.bb \
            ${LAYERDIR}/recipes*/*/*.bbappend \
            ${LAYERDIR}/images/*.bb"

BBFILE_COLLECTIONS += "meta-direwolf"
BBFILE_PATTERN_meta-direwolf := "^${LAYERDIR}/"
BBFILE_PRIORITY_meta-direwolf = "9"

LAYERSERIES_COMPAT_meta-direwolf = "thud"

# Additional license directories.
LICENSE_PATH += "${LAYERDIR}/licenses"
```
